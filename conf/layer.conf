## conf/layer.conf
```bitbake
# We have a conf and classes directory, add to BBPATH
BBPATH .= ":${LAYERDIR}"
# We have recipes-* directories, add to BBFILES
BBFILES += "${LAYERDIR}/recipes-*/*/*.bb ${LAYERDIR}/recipes*/*/*.bbappend"

BBFILE_COLLECTIONS += "hifiberry-rpi"
BBFILE_PATTERN_hifiberry-rpi = "^${LAYERDIR}/"
BBFILE_PRIORITY_hifiberry-rpi = "7"
```
